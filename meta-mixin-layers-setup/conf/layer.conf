## meta-mixin-layers-setup/conf/layer.conf
```bitbake
# We have a conf and classes directory, add to BBPATH
BBPATH .= ":${LAYERDIR}"

LAYERDEPENDS_meta-mixin-layers-setup = "core"
LAYERSERIES_COMPAT_meta-mixin-layers-setup = "kirkstone"
```
